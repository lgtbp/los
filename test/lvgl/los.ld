PROVIDE ( printf = 0xfff00000);
PROVIDE ( los_sleep = 0xfff00001);
PROVIDE ( los_get_x = 0xfff00002);
PROVIDE ( los_get_y = 0xfff00003);
PROVIDE ( los_draw_point = 0xfff00004);
PROVIDE ( los_disp_flush = 0xfff00005);
PROVIDE ( los_draw_fframe = 0xfff00006);
PROVIDE ( los_mouse_is_pressed = 0xfff00007);

