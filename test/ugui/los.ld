
PROVIDE ( functions = 167760000);
PROVIDE ( printf = 167760001);
PROVIDE ( los_get_test = 167760002);
PROVIDE ( los_sleep = 167760003);
PROVIDE ( los_get_x = 167760004);
PROVIDE ( los_get_y = 167760005);
PROVIDE ( los_draw_point = 167760006);
PROVIDE ( los_draw_line = 167760007);
PROVIDE ( los_draw_fframe = 167760008);